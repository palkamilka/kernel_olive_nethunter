## drivers/ar9271/Kconfig
```kconfig
config AR9271
	tristate "Atheros AR9271 USB WiFi"
	depends on USB
	help
	  Help message of AR9271
```

## drivers/rtl8188eus/Kconfig
```kconfig
config RTL8188EUS
	tristate "Realtek RTL8188EUS USB WiFi"
	depends on USB
	help
	  Help message of RTL8188EUS
```

## drivers/rtl8812au/Kconfig
```kconfig
config RTL8812AU
	tristate "Realtek RTL8812AU USB WiFi"
	depends on USB
	help
	  Help message of RTL8812AU
```
